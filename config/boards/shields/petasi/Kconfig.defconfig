## config/boards/shields/petasi/Kconfig.defconfig
```kconfig
if SHIELD_PETASI_LEFT

config ZMK_KEYBOARD_NAME
    default "petasi"

config ZMK_SPLIT_ROLE_CENTRAL
    default y

endif

if SHIELD_PETASI_LEFT || SHIELD_PETASI_RIGHT

config ZMK_SPLIT
    default y

endif
```

## zmk/config/boards/shields/petasi/Kconfig.shield
```kconfig
config SHIELD_PETASI_LEFT
    def_bool $(shields_list_contains,petasi_left)

config SHIELD_PETASI_RIGHT
    def_bool $(shields_list_contains,petasi_right)
```
